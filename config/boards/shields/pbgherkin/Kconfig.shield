## config/boards/shields/pbgherkin/Kconfig.shield
```kconfig
# Copyright (c) 2020 The ZMK Contributors
# SPDX-License-Identifier: MIT

config SHIELD_PBGHERKIN
   def_bool $(shields_list_contains,pbgherkin)
```
